// Copyright (c) 2025, The ZMK Contributors
// Vendored from https://github.com/badjeff/zmk-input-processor-cirque @ 2276c49 (MIT)
// SPDX-License-Identifier: MIT

#include <zephyr/dt-bindings/input/input-event-codes.h>

/ {
    /omit-if-no-ref/ zip_cirque: zip_cirque {
        compatible = "zmk,input-processor-cirque";
        #input-processor-cells = <0>;
    };

};
