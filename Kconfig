## Kconfig
```kconfig
# SPDX-License-Identifier: MIT

config TOUCAN_INPUT_FEEDER
    bool "Feed an input device's events through input processors (no HID output)"
    default y
    depends on ZMK_POINTING
    depends on DT_HAS_TOUCAN_INPUT_FEEDER_ENABLED

config TOUCAN_INPUT_PROCESSOR_TAP_GUARD
    bool "Tap guard input processor"
    default y
    depends on ZMK_POINTING
    depends on DT_HAS_TOUCAN_INPUT_PROCESSOR_TAP_GUARD_ENABLED

# Vendored from badjeff/zmk-input-processor-cirque (see src/input_processor_cirque.c)
config ZMK_INPUT_PROCESSOR_CIRQUE
    bool "Cirque GlidePoint Input Processor"
    default y
    depends on ZMK_POINTING
    depends on DT_HAS_ZMK_INPUT_PROCESSOR_CIRQUE_ENABLED
```

## config/west.yml
```yaml
manifest:
  remotes:
    - name: zmkfirmware
      url-base: https://github.com/zmkfirmware
    - name: caksoylar
      url-base: https://github.com/caksoylar
    - name: badjeff
      url-base: https://github.com/badjeff
  projects:
    - name: zmk
      remote: zmkfirmware
      revision: main
      import: app/west.yml
    - name: zmk-rgbled-widget
      remote: caksoylar
      revision: main
    - name: zmk-input-processor-cirque
      remote: badjeff
      revision: 2276c4973f0a0a160a58bb38f61e3064682eda6f # main @ 2026-11
  self:
    path: config
```

## dts/bindings/toucan,input-feeder.yaml
```yaml
# SPDX-License-Identifier: MIT

description: |
  Runs every event from an input device through a chain of input processors and
  does nothing else (no HID reports). Useful on a split peripheral, where
  zmk,input-listener is not available, to drive a processor that re-emits its
  results on its own virtual device (e.g. &zip_cirque), which a zmk,input-split
  then forwards to the central.

  Unlike a second zmk,input-split, this adds no GATT characteristic, so the
  peripheral still exposes a single split input to the central.

compatible: "toucan,input-feeder"

properties:
  device:
    type: phandle
    required: true
    description: The input device whose events are fed to the processors.
  input-processors:
    type: phandle-array
    required: true
```

## dts/bindings/toucan,input-processor-tap-guard.yaml
```yaml
# SPDX-License-Identifier: MIT

description: |
  Suppresses the small cursor jitter of a tap so that taps (and double taps) land
  on the same pixel. When relative motion starts after a pause, it is held back
  until its accumulated distance reaches `threshold`; if the movement never gets
  that far (a tap), it is dropped. Once the threshold is crossed, the held-back
  motion is released in full and further motion passes through untouched until
  the next pause.

compatible: "toucan,input-processor-tap-guard"

include: ip_zero_param.yaml

properties:
  threshold:
    type: int
    default: 24
    description: Distance (|x| + |y|, in input units) motion must exceed to pass.
  idle-ms:
    type: int
    default: 80
    description: A gap without motion this long starts a new guarded movement.
```
